## conf/layer.conf
```bitbake
# We have a conf and classes directory, add to BBPATH
BBPATH .= ":${LAYERDIR}"

# We have recipes-* directories, add to BBFILES
BBFILES += "${LAYERDIR}/recipes-*/*.bb ${LAYERDIR}/recipes-*/*.bbappend"

BBFILE_COLLECTIONS += "smstools3"
BBFILE_PATTERN_smstools3 = "^${LAYERDIR}/"
BBFILE_PRIORITY_smstools3 = "1"

# This should only be incremented on significant changes that will
# cause compatibility issues with other layers
LAYERVERSION_smstools3 = "1"
```
